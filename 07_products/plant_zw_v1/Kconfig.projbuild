## 07_products/plant_zw_v1/Kconfig.projbuild
```kconfig
menu "ZW V1.0 board bring-up"
config ZW_BOARD_POWER_PATH_VERIFIED
    bool "PNP base current limiting and power-domain isolation verified on the physical board"
    default n
    help
        The supplied PCB ties PCF8574 outputs directly to PNP bases. The 10k
        resistors are base-emitter pullups, not series current limiting.
        Confirm hardware correction/current limits before enabling this target.
        Default firmware prints a diagnostic and does not initialize the loads.
config ZW_TEST_AUDIO
    bool "Run one ES8311 microphone level test at boot"
    default n
    help
        Bench test only. Captures PCM then enters codec standby and stops I2S.
        This does not implement speech recognition or continuous audio wake.
config ZW_TEST_DEEP_SLEEP
    bool "Enter deep sleep after 30 seconds, wake every 60 seconds or on touch"
    default n
    help
        Measurement mode. USB will disconnect in deep sleep. No BLE connection
        is maintained. Actuators and charging stay disabled; shared I2C rail
        and codec digital supply stay on with codec in software standby.
endmenu
```

## sdkconfig.defaults
```kconfig
CONFIG_IDF_TARGET="esp32c3"
CONFIG_PARTITION_TABLE_CUSTOM=y
CONFIG_PARTITION_TABLE_CUSTOM_FILENAME="partitions.csv"
CONFIG_PARTITION_TABLE_OFFSET=0x8000
CONFIG_ESPTOOLPY_FLASHSIZE_4MB=y
CONFIG_COMPILER_CXX_EXCEPTIONS=n
CONFIG_COMPILER_CXX_RTTI=n
CONFIG_BOOTLOADER_APP_ROLLBACK_ENABLE=y
CONFIG_PM_ENABLE=y
CONFIG_FREERTOS_USE_TICKLESS_IDLE=y
CONFIG_BT_ENABLED=y
CONFIG_BT_NIMBLE_ENABLED=y
CONFIG_BT_NIMBLE_ROLE_PERIPHERAL=y
CONFIG_BT_NIMBLE_ROLE_CENTRAL=n
CONFIG_BT_NIMBLE_MAX_CONNECTIONS=1
CONFIG_BT_NIMBLE_ATT_PREFERRED_MTU=517
CONFIG_BT_NIMBLE_NVS_PERSIST=y
CONFIG_BT_NIMBLE_MAX_BONDS=3
# 无显示/键盘的 Just Works 只能达到“未认证配对 + 加密”；启用 SC Only 会把所有受保护
# GATT 属性提升为要求 MITM 认证的安全等级 4，导致绑定后仍无法写入。
CONFIG_BT_NIMBLE_SM_SC_ONLY=0
CONFIG_BT_CTRL_MODEM_SLEEP=y
CONFIG_BT_CTRL_MODEM_SLEEP_MODE_1=y
CONFIG_BT_CTRL_LPCLK_SEL_MAIN_XTAL=y
CONFIG_BT_CTRL_MAIN_XTAL_PU_DURING_LIGHT_SLEEP=y
```
